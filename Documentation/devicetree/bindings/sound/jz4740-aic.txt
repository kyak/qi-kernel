## Documentation/devicetree/bindings/sound/jz4740-aic.txt
```
JZ4740 audio controller

Required properties:
	compatible: Must be "ingenic,jz4740-dma"
	reg: The audio controller's regsiters location and length
	clocks: Phandles to the aic and i2s clock
	clock-names: "aic", "i2s"
	dmas: Phandles to the transmit and receive DMA streams
	dma-names: Names for the DMA streams. These strings correspond 1:1 with the
	 ordered pairs in dmas. Valid values are "tx" and "rx"

Example:
	aic: aic@20000 {
		compatible = "ingenic,jz4740-aic";
		reg = <0x20000 0x80>;
		interrupts = <18>;

		clocks = <&aic_clk &i2s_clk>;
		clock-names = "aic", "i2s";

		dmas = <&dmac 0 0 0 &dmac 0 0 0>;
		dma-names = "tx", "rx";
	};
```

## arch/mips/jz4740/Kconfig
```kconfig
choice
	prompt "Machine type"
	depends on MACH_JZ4740
	default JZ4740_QI_LB60

config JZ4740_QI_LB60
	bool "Qi Hardware Ben NanoNote"

config JZ4740_N516
	bool "Hanvon n516 eBook reader"
	select SOC_JZ4740

config JZ4740_N526
	bool "Hanvon n526 eBook reader"
	select SOC_JZ4740

config JZ4740_ID800WT
	bool "Sungale id800wt picture frame"
	select SOC_JZ4740

config JZ4740_A320
	bool "Dingoo A320 game and media player"
	select SYS_SUPPORTS_ZBOOT

endchoice

config HAVE_PWM
	bool
```

## drivers/i2c/chips/Kconfig
```kconfig
#
# Miscellaneous I2C chip drivers configuration
#
# *** DEPRECATED! Do not add new entries! See Makefile ***
#

menu "Miscellaneous I2C Chip support"

config DS1682
	tristate "Dallas DS1682 Total Elapsed Time Recorder with Alarm"
	depends on EXPERIMENTAL
	help
	  If you say yes here you get support for Dallas Semiconductor
	  DS1682 Total Elapsed Time Recorder.

	  This driver can also be built as a module.  If so, the module
	  will be called ds1682.

config SENSORS_TSL2550
	tristate "Taos TSL2550 ambient light sensor"
	depends on EXPERIMENTAL
	help
	  If you say yes here you get support for the Taos TSL2550
	  ambient light sensor.

	  This driver can also be built as a module.  If so, the module
	  will be called tsl2550.

config N516_LPC
	tristate "N516 keys & power controller"
	depends on I2C
	depends on INPUT
	depends on POWER_SUPPLY
	help
	  N516 keyboard & power controller driver

config N526_LPC
	tristate "N526 LPC934 coprocessor"
	depends on JZ4740_N526
	help
	  If you say yes here you get support for the N526s NXP LPC934 coprocessor.
	  It is used as a keyboard controllor and for power management.

	  If you have a N526 you probably want to say Y here.

endmenu
```
